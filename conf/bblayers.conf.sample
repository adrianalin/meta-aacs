## conf/bblayers.conf.sample
```bitbake
# POKY_BBLAYERS_CONF_VERSION is increased each time build/conf/bblayers.conf
# changes incompatibly
POKY_BBLAYERS_CONF_VERSION = "2"

BBPATH = "${TOPDIR}"
BBFILES ?= ""

BBLAYERS ?= " \
  ${HOME}/yocto/poky-dunfell/meta \
  ${HOME}/yocto/poky-dunfell/meta-poky \
  ${HOME}/yocto/poky-dunfell/meta-openembedded/meta-oe \
  ${HOME}/yocto/poky-dunfell/meta-openembedded/meta-multimedia \
  ${HOME}/yocto/poky-dunfell/meta-openembedded/meta-networking \
  ${HOME}/yocto/poky-dunfell/meta-openembedded/meta-perl \
  ${HOME}/yocto/poky-dunfell/meta-openembedded/meta-python \
  ${HOME}/yocto/poky-dunfell/meta-raspberrypi \
  ${HOME}/yocto/poky-dunfell/meta-security \
  ${HOME}/yocto/poky-dunfell/meta-aacs \
"
```

## conf/layer.conf
```bitbake
# We have a conf and classes directory, add to BBPATH
BBPATH .= ":${LAYERDIR}"

# We have recipes-* directories, add to BBFILES
BBFILES += "${LAYERDIR}/recipes-*/*/*.bb \
            ${LAYERDIR}/images/*.bb"

BBFILES += " \
${LAYERDIR}/recipes-multimedia/gstreamer/gstreamer1.0-plugins-ugly_%.bbappend \
${LAYERDIR}/recipes-connectivity/openssh/openssh_8%.bbappend \
"

BBFILES_DYNAMIC += " \
odroid-layer:${LAYERDIR}/recipes-kernel/linux/linux-yocto_5.10.bbappend \
raspberrypi:${LAYERDIR}/recipes-bsp/bootfiles/rpi-config_git.bbappend \
raspberrypi:${LAYERDIR}/recipes-bsp/alsa-state/alsa-state.bbappend \
"

BBFILE_COLLECTIONS += "meta-aacs"
BBFILE_PATTERN_meta-aacs = "^${LAYERDIR}/"
BBFILE_PRIORITY_meta-aacs = "10"

LAYERDEPENDS_meta-aacs = "core openembedded-layer"
LAYERSERIES_COMPAT_meta-aacs = "dunfell gatesgarth"
```

## conf/local.conf.sample
```bitbake
# Local configuration for meta-rpi images
# Yocto Project 3.1 Poky distribution [dunfell] branch
# This is a sysvinit system

# mask wireguard from meta-openembedded/meta-networking
# use version in meta-jumpnow to support kernels < 5.6
# with wireguard-linux-compat
BBMASK = "meta-networking/recipes-kernel/wireguard"

LICENSE_FLAGS_WHITELIST = "commercial"

DISTRO_FEATURES_append = " pulseaudio bluetooth ext2 usbhost ${DISTRO_FEATURES_LIBC} systemd "

IMAGE_FEATURES += "x11-base"

PREFERRED_PROVIDER_jpeg = "libjpeg-turbo"
PREFERRED_PROVIDER_jpeg-native = "libjpeg-turbo-native"

PREFERRED_PROVIDER_udev = "eudev"

VIRTUAL-RUNTIME_init_manager = "systemd"
VIRTUAL-RUNTIME_initscripts = ""

MACHINE_FEATURES_remove = "apm"

IMAGE_FSTYPES = "wic.bz2"

MACHINE = "raspberrypi4-64"

KERNEL_IMAGETYPE = "Image"

# uncomment for kernels < 5.6
WIREGUARD_COMPAT = "1"

DISABLE_OVERSCAN = "1"
# ENABLE_UART = "1"
SERIAL_CONSOLES = ""

# default to 5.4
PREFERRED_VERSION_linux-raspberrypi = "5.4.%"
# PREFERRED_VERSION_linux-raspberrypi = "4.19.%"

# DL_DIR = "/src/oe"
# SSTATE_DIR = "/oe8/rpi64/sstate-cache"
# TMPDIR = "/oe8/rpi64/tmp-zeus"

DISTRO = "poky"
PACKAGE_CLASSES = "package_ipk"

# i686 or x86_64
SDKMACHINE = "x86_64"

# for no root passwd uncomment the following and comment the two extra user lines
# EXTRA_IMAGE_FEATURES = "debug-tweaks"

# for a root passwd, change jumpnowtek below to your password
INHERIT += "extrausers"
EXTRA_USERS_PARAMS = "\
	usermod -P raspberry root; \
	useradd -P raspberry -G sudo pi; \
	groupadd netdev ; \
"


# this will force root to change password on first login
# INHERIT += "chageusers"
# CHAGE_USERS_PARAMS = "chage -d0 root; "

USER_CLASSES = "image-mklibs image-prelink"
PATCHRESOLVE = "noop"
RM_OLD_IMAGE = "1"
# INHERIT += "rm_work"
CONF_VERSION = "1"
```
